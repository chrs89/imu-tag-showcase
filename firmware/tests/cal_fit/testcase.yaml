## firmware/tests/cal_fit/testcase.yaml
```yaml
tests:
  imu_tag.cal_fit:
    platform_allow:
      - native_sim
    integration_platforms:
      - native_sim
    tags: imu_tag unit
```

## firmware/tests/fifo_decode/testcase.yaml
```yaml
tests:
  imu_tag.fifo_decode:
    platform_allow:
      - native_sim
    integration_platforms:
      - native_sim
    tags: imu_tag unit
```

## firmware/tests/madgwick/testcase.yaml
```yaml
tests:
  imu_tag.madgwick:
    platform_allow:
      - native_sim
    integration_platforms:
      - native_sim
    tags: imu_tag unit
```
