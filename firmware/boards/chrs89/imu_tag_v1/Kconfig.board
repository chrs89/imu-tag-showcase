## firmware/boards/chrs89/imu_tag_v1/Kconfig.board
```kconfig
config BOARD_IMU_TAG_V1
	bool "IMU Tag v1 — E73-2G4M08S1C (nRF52840) custom PCB"
```

## firmware/boards/chrs89/imu_tag_v1/board.yml
```yaml
board:
  name: imu_tag_v1
  full_name: "IMU Tag v1 (E73-2G4M08S1C)"
  vendor: chrs89
  socs:
    - name: nrf52840
```

## firmware/tests/dsp_accumulator/testcase.yaml
```yaml
tests:
  imu_tag.dsp_accumulator:
    platform_allow:
      - native_sim
    integration_platforms:
      - native_sim
    tags: imu_tag unit
```
